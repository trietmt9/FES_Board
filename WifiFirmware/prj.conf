## CMakeLists.txt
```
cmake_minimum_required(VERSION 3.20.0)
find_package(Zephyr REQUIRED HINTS $ENV{ZEPHYR_BASE})

project(WifiFirmware)

target_sources(app PRIVATE src/main.c)
```

## prj.conf
```kconfig
# nRF7002DK, nRF Connect SDK. Trimmed from nrf/samples/wifi/sta.
# SSID and password come from credentials.conf (not in git).

# ---- Wi-Fi ----
CONFIG_WIFI=y
CONFIG_WIFI_NRF70=y
CONFIG_WIFI_NM_WPA_SUPPLICANT=y
CONFIG_WIFI_READY_LIB=y
CONFIG_NRF_WIFI_RPU_RECOVERY=y
CONFIG_WIFI_CREDENTIALS=y
CONFIG_WIFI_CREDENTIALS_STATIC=y

# ---- Network ----
CONFIG_NETWORKING=y
CONFIG_NET_L2_ETHERNET=y
CONFIG_NET_L2_ETHERNET_MGMT=y
CONFIG_NET_IPV4=y
CONFIG_NET_IPV6=n
CONFIG_NET_DHCPV4=y
CONFIG_NET_TCP=y
CONFIG_NET_SOCKETS=y
CONFIG_NET_MAX_CONTEXTS=5
CONFIG_ZVFS_POLL_MAX=10
CONFIG_NET_MGMT_EVENT_QUEUE_TIMEOUT=5000

CONFIG_NET_PKT_RX_COUNT=16
CONFIG_NET_PKT_TX_COUNT=16
CONFIG_NRF70_RX_NUM_BUFS=16
CONFIG_NET_BUF_RX_COUNT=16
CONFIG_NET_BUF_TX_COUNT=32
CONFIG_NET_TC_TX_COUNT=1
CONFIG_NET_IF_UNICAST_IPV4_ADDR_COUNT=1

CONFIG_HEAP_MEM_POOL_SIZE=37000
CONFIG_HEAP_MEM_POOL_IGNORE_MIN=y
CONFIG_NRF_WIFI_CTRL_HEAP_SIZE=20000
CONFIG_NRF_WIFI_DATA_HEAP_SIZE=40000

CONFIG_MAIN_STACK_SIZE=5200
CONFIG_NET_TX_STACK_SIZE=4096
CONFIG_NET_RX_STACK_SIZE=4096

# Real entropy comes from the CryptoCell, so no test random generator is needed.
CONFIG_ENTROPY_GENERATOR=y

CONFIG_LOG=y
CONFIG_LOG_BUFFER_SIZE=2048
```

## boards/nrf7002dk_nrf5340_cpuapp.overlay
```dts
/*
 * Devicetree overlay — nRF7002DK, nRF5340 application core.
 *
 * Picked up AUTOMATICALLY by the build: Zephyr looks for
 * boards/<board target with / replaced by _>.overlay, so building
 * `-b nrf7002dk/nrf5340/cpuapp` loads exactly this file. Rename it and it is
 * silently ignored with no warning, which is an easy half-hour to lose.
 *
 * Nothing in here is REQUIRED — the DK's own board files already describe the
 * nRF7002 completely (QSPI on P0.13-P0.18, iovdd-ctrl P0.31, bucken P0.12,
 * host-irq P0.23, coex on P0.24/28/29/30) and the scan in src/main.c works
 * with this file empty. It exists as the correct place to put app-specific
 * hardware changes, and the examples below are the ones you are actually
 * likely to reach for while learning.
 *
 * To check what the overlay actually did, read the merged devicetree:
 *   build/zephyr/zephyr.dts
 * That is the ground truth — never assume an override landed.
 */

/* ---------------------------------------------------------------------------
 * Example 1 — slow the QSPI bus down.
 *
 * The DK runs the nRF7002 link at 24 MHz. If the radio fails to initialise
 * (no Wi-Fi interface at boot) this is the first thing to try: a slower bus
 * rules out signal-integrity problems before you suspect firmware. Also worth
 * doing on a custom board whose QSPI routing is longer than the DK's.
 * --------------------------------------------------------------------------- */
/*
&nrf70 {
	qspi-frequency = <8000000>;
};
*/

/* ---------------------------------------------------------------------------
 * Example 2 — 2.4 GHz only.
 *
 * The DK board file includes nrf70_common_5g.dtsi, which sets the 5 GHz
 * transmit-power limits and makes the part dual-band. Dropping to 2.4 GHz only
 * halves scan time and saves power. There is no node to override for this —
 * it is a Kconfig choice, so it belongs in prj.conf, not here:
 *
 *   CONFIG_NRF70_2_4G_ONLY=y
 *
 * Noted in the overlay anyway because this is where people look for it first.
 * --------------------------------------------------------------------------- */

/* ---------------------------------------------------------------------------
 * Example 3 — turn off Bluetooth/Wi-Fi coexistence.
 *
 * The DK enables the coex interface so a Bluetooth controller on the network
 * core can arbitrate for the radio. With no Bluetooth in this app it does
 * nothing, but disabling it frees P0.24/P0.28/P0.29/P0.30 if you want them as
 * plain GPIO for probing.
 * --------------------------------------------------------------------------- */
/*
&nrf_radio_coex {
	status = "disabled";
};
*/

/* ---------------------------------------------------------------------------
 * Example 4 — a scan-activity LED.
 *
 * The DK already provides led0/led1 aliases, so nothing needs adding to use
 * them from C:
 *
 *   static const struct gpio_dt_spec led =
 *           GPIO_DT_SPEC_GET(DT_ALIAS(led0), gpios);
 *
 * You would only add a node here for an LED the board does NOT have — for
 * example one wired to a header pin:
 * --------------------------------------------------------------------------- */
/*
/ {
	leds {
		compatible = "gpio-leds";

		scan_led: led_scan {
			gpios = <&gpio1 7 GPIO_ACTIVE_HIGH>;
			label = "Scan activity";
		};
	};

	aliases {
		scan-led = &scan_led;
	};
};
*/
```

## src/main.c
```c
/*
 * nRF7002DK (nRF Connect SDK): join Wi-Fi with stored credentials, get an IP by
 * DHCP, then listen on TCP 5000 and send a line once a second to whoever connects.
 *
 * Follows nrf/samples/wifi/sta. SSID/password: credentials.conf (not in git).
 */

#include <zephyr/kernel.h>
#include <zephyr/logging/log.h>
#include <zephyr/net/ethernet_mgmt.h>
#include <zephyr/net/net_event.h>
#include <zephyr/net/net_if.h>
#include <zephyr/net/socket.h>
#include <zephyr/net/wifi_mgmt.h>
#include <net/wifi_ready.h>

LOG_MODULE_REGISTER(app, LOG_LEVEL_INF);

#define PORT 5000

/* Used when the nRF70 OTP holds no MAC (set in app.overlay). */
static const uint8_t dts_mac[6] = DT_PROP_OR(DT_CHOSEN(zephyr_wifi), local_mac_address, {0});

static K_SEM_DEFINE(ready, 0, 1);
static K_SEM_DEFINE(joined, 0, 1);
static K_SEM_DEFINE(got_ip, 0, 1);
static int join_status;
/* Two callbacks: one callback cannot mix events from different net_mgmt layers. */
static struct net_mgmt_event_callback wifi_cb, ip_cb;

static void wifi_ready_cb(bool up)
{
	if (up) {
		k_sem_give(&ready);
	}
}

static void on_wifi_event(struct net_mgmt_event_callback *c, uint64_t ev, struct net_if *iface)
{
	join_status = ((const struct wifi_status *)c->info)->status;
	k_sem_give(&joined);
}

static void on_ip_event(struct net_mgmt_event_callback *c, uint64_t ev, struct net_if *iface)
{
	k_sem_give(&got_ip);
}

int main(void)
{
	struct net_if *iface = net_if_get_first_wifi();
	wifi_ready_callback_t rcb = { .wifi_ready_cb = wifi_ready_cb };

	if (!iface) {
		LOG_ERR("no Wi-Fi interface");
		return -ENODEV;
	}
	register_wifi_ready_callback(rcb, iface);

	net_mgmt_init_event_callback(&wifi_cb, on_wifi_event, NET_EVENT_WIFI_CONNECT_RESULT);
	net_mgmt_add_event_callback(&wifi_cb);
	net_mgmt_init_event_callback(&ip_cb, on_ip_event, NET_EVENT_IPV4_DHCP_BOUND);
	net_mgmt_add_event_callback(&ip_cb);

	/* Zephyr will not bring an Ethernet-type interface up without a valid MAC. */
	struct net_linkaddr *la = net_if_get_link_addr(iface);

	if (la->len != 6 || !net_eth_is_addr_valid((struct net_eth_addr *)la->addr)) {
		struct ethernet_req_params mp;

		memcpy(mp.mac_address.addr, dts_mac, sizeof(dts_mac));
		net_mgmt(NET_REQUEST_ETHERNET_SET_MAC_ADDRESS, iface, &mp, sizeof(mp));
		int up = net_if_up(iface);

		if (up && up != -EALREADY) {
			LOG_ERR("cannot bring the Wi-Fi interface up (%d)", up);
			return up;
		}
	}

	if (k_sem_take(&ready, K_SECONDS(15))) {
		LOG_ERR("Wi-Fi did not become ready");
		return -ETIMEDOUT;
	}

	LOG_INF("joining the stored network...");
	int ret = net_mgmt(NET_REQUEST_WIFI_CONNECT_STORED, iface, NULL, 0);

	if (ret) {
		LOG_ERR("connect request rejected (%d)", ret);
		return ret;
	}
	/* Wait up to 72 s, and show where the supplicant is while we do. */
	bool done = false;

	for (int i = 0; i < 24 && !done; i++) {
		done = k_sem_take(&joined, K_SECONDS(3)) == 0;
		if (!done) {
			struct wifi_iface_status st = { 0 };

			net_mgmt(NET_REQUEST_WIFI_IFACE_STATUS, iface, &st, sizeof(st));
			LOG_INF("waiting to join... state: %s", wifi_state_txt(st.state));
		}
	}
	if (!done) {
		LOG_ERR("no join result after 72 s - network not found, or security mismatch");
		return -ETIMEDOUT;
	}
	if (join_status) {
		LOG_ERR("join failed (status %d)", join_status);
		return -ECONNREFUSED;
	}
	if (k_sem_take(&got_ip, K_SECONDS(30))) {
		LOG_ERR("joined, but DHCP gave no address");
		return -ETIMEDOUT;
	}

	char ip[NET_IPV4_ADDR_LEN];

	net_addr_ntop(AF_INET, net_if_ipv4_get_global_addr(iface, NET_ADDR_PREFERRED), ip,
		      sizeof(ip));
	LOG_INF("connected, IP %s - listening on port %d", ip, PORT);

	int srv = zsock_socket(AF_INET, SOCK_STREAM, IPPROTO_TCP);
	struct sockaddr_in a = {
		.sin_family = AF_INET,
		.sin_port = htons(PORT),
		.sin_addr.s_addr = htonl(INADDR_ANY),
	};

	if (srv < 0 || zsock_bind(srv, (struct sockaddr *)&a, sizeof(a)) ||
	    zsock_listen(srv, 1)) {
		LOG_ERR("cannot listen on port %d", PORT);
		return -errno;
	}

	for (;;) {
		int c = zsock_accept(srv, NULL, NULL);

		if (c < 0) {
			continue;
		}
		LOG_INF("client connected");
		for (int n = 0;; n++) {
			char msg[40];
			int len = snprintk(msg, sizeof(msg), "hello from nRF7002 %d\n", n);

			if (zsock_send(c, msg, len, 0) < 0) {
				break;
			}
			k_sleep(K_SECONDS(1));
		}
		zsock_close(c);
		LOG_INF("client left");
	}
}
```

## inc/wifi_app.h
```c
/**
 * @file wifi_app.h
 * @brief Wi-Fi helpers for the nRF7002DK learning app.
 *
 * Deliberately small. One job per function, so each can be read, flashed and
 * understood on its own before the next is added.
 */

#ifndef __WIFI_APP_H__
#define __WIFI_APP_H__

#include <zephyr/kernel.h>
#include <zephyr/net/net_if.h>
#include <zephyr/net/net_mgmt.h>
#include <zephyr/net/wifi_mgmt.h>

/**
 * @brief How many access points the scan table holds.
 *
 * Results are stored, not printed, as they arrive - printing from the
 * net_mgmt event thread drops them (see the note at the top of main.c). This
 * is the size of that store. Anything beyond it is counted and reported, never
 * silently discarded. 32 covers a busy office; a crowded apartment block can
 * exceed it.
 */
#define WIFI_APP_MAX_RESULTS 32

/**
 * @brief Subscribe to the Wi-Fi management events this app prints.
 *
 * Register BEFORE starting a scan. Results are delivered as net_mgmt events,
 * one per access point, and any that arrive before the callback exists are
 * simply lost - there is no backlog to replay.
 *
 * @return 0 on success, negative errno on failure.
 */
int wifi_app_events_init(void);

/**
 * @brief Find the Wi-Fi interface.
 *
 * On the nRF7002DK this is the nRF7002 reached over SPI from the nRF5340
 * application core. It exists only once the driver has loaded its firmware
 * patch from the nRF70 blob, so a NULL return usually means the driver failed
 * to bring the radio up rather than that the board is wrong.
 *
 * @return The interface, or NULL if there is no Wi-Fi interface.
 */
struct net_if *wifi_app_iface(void);

/**
 * @brief Start an access-point scan.
 *
 * Returns as soon as the request is accepted; results arrive later on the
 * callback registered by wifi_app_events_init(). Completion is signalled by
 * NET_EVENT_WIFI_SCAN_DONE, not by this function returning.
 *
 * Clears the result table, so do not call it while a previous scan is still
 * running.
 *
 * @param iface Interface from wifi_app_iface().
 * @return 0 if the scan was accepted, negative errno otherwise.
 */
int wifi_app_scan(struct net_if *iface);

#endif /* __WIFI_APP_H__ */
```
